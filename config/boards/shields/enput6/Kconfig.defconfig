## config/boards/shields/enput6/Kconfig.defconfig
```kconfig
# Copyright (c) 2022 The ZMK Contributors
# SPDX-License-Identifier: MIT

if SHIELD_ENPUT6

config ZMK_KEYBOARD_NAME
    default "enput6"

endif
```

## config/boards/shields/enput6/Kconfig.shield
```kconfig
# Copyright (c) 2022 The ZMK Contributors
# SPDX-License-Identifier: MIT

config SHIELD_ENPUT6
   def_bool $(shields_list_contains,enput6)
```
